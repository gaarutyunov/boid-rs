## boid-esp32/sdkconfig.defaults
```kconfig
# ESP32-S3 SDK Configuration Defaults

# QEMU-specific settings
# Uncomment these when building with --features qemu
#CONFIG_ETH_USE_OPENETH=y
#CONFIG_MBEDTLS_HARDWARE_AES=n
#CONFIG_MBEDTLS_HARDWARE_SHA=n

# General ESP32-S3 settings
CONFIG_ESP32S3_DEFAULT_CPU_FREQ_240=y
CONFIG_ESPTOOLPY_FLASHSIZE_4MB=y

# Logging
CONFIG_LOG_DEFAULT_LEVEL_INFO=y
CONFIG_LOG_MAXIMUM_LEVEL_INFO=y

# WiFi settings
CONFIG_ESP32_WIFI_STATIC_RX_BUFFER_NUM=10
CONFIG_ESP32_WIFI_DYNAMIC_RX_BUFFER_NUM=32
CONFIG_ESP32_WIFI_DYNAMIC_TX_BUFFER_NUM=32

# HTTP server
CONFIG_HTTPD_MAX_REQ_HDR_LEN=1024
CONFIG_HTTPD_MAX_URI_LEN=512
```
